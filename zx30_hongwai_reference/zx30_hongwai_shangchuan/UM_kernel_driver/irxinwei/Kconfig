## zx30_hongwai_reference/zx30_hongwai_shangchuan/UM_kernel_driver/irxinwei/Kconfig
```kconfig
#
# Test device configuration
#

menuconfig Mobile_Ctrl

if Mobile_Ctrl

config MOBILE_ET
	def_bool y
	bool "Mobile Driver"
	default y

endif
```
